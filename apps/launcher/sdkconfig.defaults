## apps/muse/sdkconfig.defaults
```kconfig
CONFIG_IDF_TARGET="esp32s3"
CONFIG_ESPTOOLPY_FLASHSIZE_8MB=y
CONFIG_ESPTOOLPY_FLASHMODE_QIO=y
CONFIG_PARTITION_TABLE_CUSTOM=y
CONFIG_PARTITION_TABLE_CUSTOM_FILENAME="../../partitions.csv"
CONFIG_SPIRAM=y
CONFIG_SPIRAM_MODE_OCT=y
CONFIG_SPIRAM_SPEED_80M=y
CONFIG_SPIRAM_USE_MALLOC=y
CONFIG_SPIRAM_TRY_ALLOCATE_WIFI_LWIP=y
CONFIG_MBEDTLS_EXTERNAL_MEM_ALLOC=y
CONFIG_BT_ENABLED=n
CONFIG_MBEDTLS_CERTIFICATE_BUNDLE=y
CONFIG_ESP_CONSOLE_USB_SERIAL_JTAG=y

# LVGL 9
CONFIG_LV_COLOR_DEPTH_16=y
CONFIG_LV_USE_CLIB_MALLOC=y
CONFIG_LV_USE_CLIB_STRING=y
CONFIG_LV_USE_CLIB_SPRINTF=y
CONFIG_LV_DEF_REFR_PERIOD=20
CONFIG_LV_BUILD_EXAMPLES=n

# SoftAP is never used (STA only)
CONFIG_ESP_WIFI_SOFTAP_SUPPORT=n

# app_main also runs TLS (OAuth device flow) + 2KB of request buffers
CONFIG_ESP_MAIN_TASK_STACK_SIZE=16384
```

## components/bsp_143c/Kconfig
```kconfig
menu "Waveshare 1.43C BSP"

    config BSP_AUDIO_BOOT_SELFTEST
        bool "Audio self-test at init (1 kHz beep + mic level on the log)"
        default y
        help
            When bsp_audio_init() runs, play a 150 ms beep through ES8311 and log
            the RMS / peak level of the first two ES7210 channels for 0.4 s.

    config BSP_AUDIO_SPK_VOLUME
        int "Speaker volume (0-100)"
        range 0 100
        default 80

    config BSP_AUDIO_MIC_GAIN_DB
        int "Microphone PGA gain (dB)"
        range 0 37
        default 30

endmenu
```

## components/pendant_wifi/Kconfig
```kconfig
menu "Pendant WiFi"

    config PENDANT_WIFI_DEFAULT_SSID
        string "Fallback WiFi SSID"
        default ""
        help
            Used only when the shared `pendant` NVS namespace has no SSID
            (i.e. the device was never provisioned). Leave empty to require
            provisioning via USB (`provision.py --wifi-only`).

    config PENDANT_WIFI_DEFAULT_PASSWORD
        string "Fallback WiFi password"
        default ""

endmenu
```
